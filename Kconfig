## Kconfig
```kconfig
config DALI_NRF54
	bool "DALI-2 add-on module for nRF54L15"
	help
	  Enables the CPUAPP-side DALI API frontend and IPC transport for the
	  CPUFLPR runtime.

rsource "cpuflpr/Kconfig.flpr"
```

## west.yml
```yaml
# Copyright (c) 2026
# SPDX-License-Identifier: Apache-2.0

manifest:
  remotes:
    - name: ncs
      url-base: https://github.com/nrfconnect

  projects:
    - name: nrf
      remote: ncs
      repo-path: sdk-nrf
      revision: v3.0.2
      import: true

  self:
    path: dali-nrf54
```
